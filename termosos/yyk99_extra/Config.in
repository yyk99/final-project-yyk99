## yyk99_extra/Config.in
```kconfig
source "$BR2_EXTERNAL_yyk99_extra_PATH/package/pino_eth0/Config.in"
source "$BR2_EXTERNAL_yyk99_extra_PATH/package/termosos/Config.in"
source "$BR2_EXTERNAL_yyk99_extra_PATH/package/libbcm2835-dev/Config.in"
source "$BR2_EXTERNAL_yyk99_extra_PATH/package/iot_in_c/Config.in"
```

## yyk99_extra/package/iot_in_c/Config.in
```kconfig
config BR2_PACKAGE_IOT_IN_C
    bool "iot_in_c"
    help
      Collection of IOT related apps (based on the IOT in C book)
```

## yyk99_extra/package/libbcm2835-dev/Config.in
```kconfig
config BR2_PACKAGE_LIBBCM2835_DEV
    bool "libbcm2835-dev"
    help
      Include libbcm2835-dev development headers and libs
```

## yyk99_extra/package/pino_eth0/Config.in
```kconfig
config BR2_PACKAGE_PINO_ETH0
    bool "pino_eth0"
    help
      Configure USB eth0 if present
```

## yyk99_extra/package/termosos/Config.in
```kconfig
config BR2_PACKAGE_TERMOSOS
    bool "termosos"
    help
      Include termosos stuff (driver and server)
```
